## Custom Firmware/Module/zephyr/Kconfig
```kconfig
menuconfig SHINYGO60
    bool "ShinyGo60 integration"
    default n
    help
      Enable the ShinyGo60 firmware integration.

config SHINYGO60_CENTRAL
    bool
    default y if SHINYGO60 && BOARD_GO60_LH
    help
      Build ShinyGo60 runtime code only for the Go60 central/left image. The
      right/peripheral image shares the configuration but compiles no runtime
      source from this module.

config SHINYGO60_PROTOCOL
    bool
    default y if SHINYGO60_CENTRAL
    depends on SHINYGO60_CENTRAL && SHINYGO60_BATTERY_TELEMETRY
    select RING_BUFFER
    help
      Add the bounded ShinyGo60 protocol over USB CDC and encrypted Bluetooth
      GATT on the Go60 central.

config SHINYGO60_BATTERY_TELEMETRY
    bool
    default y if SHINYGO60
    depends on SHINYGO60 && ZMK_BATTERY_REPORTING
    help
      Re-publish ZMK's cached battery reading at a low frequency so the central
      can distinguish fresh and stale values for both keyboard halves without
      requesting extra battery sensor samples.

config SHINYGO60_BATTERY_HEARTBEAT_SECONDS
    int
    default 60
    depends on SHINYGO60_BATTERY_TELEMETRY
    help
      Seconds between cached battery heartbeats while the keyboard is active.

config SHINYGO60_BATTERY_STALE_SECONDS
    int
    default 150
    depends on SHINYGO60_BATTERY_TELEMETRY
    help
      Seconds without a battery observation before its last value is stale.

config SHINYGO60_BLE_INTERACTIVE_LATENCY
    int "Bluetooth peripheral latency while Windows is active"
    range 0 499
    default 4
    depends on SHINYGO60_PROTOCOL && ZMK_BLE
    help
      Requested Bluetooth peripheral latency while the companion detects an
      unlocked, recently active Windows session. A value of four permits up to
      four skipped connection events when the keyboard has nothing to send.

config SHINYGO60_BLE_INTERACTIVE_LEASE_SECONDS
    int "Maximum interactive Bluetooth time without companion traffic"
    range 30 600
    default 90
    depends on SHINYGO60_PROTOCOL && ZMK_BLE
    help
      Return to the power-saving peripheral latency if the companion vanishes
      without disabling its GATT subscription. Normal Bluetooth health checks
      renew this lease while the companion remains connected.

config SHINYGO60_LAYOUT_IDENTIFIER
    string "Generated ShinyGo60 layout identifier"
    default "sg60-v1-00000000000000010000000000000000"
    depends on SHINYGO60
    help
      Layout identifier generated from the exact keymap and protocol version.
      The default is a non-production identity for manual builds; the headless
      builder supplies the matched production value.

config SHINYGO60_KEYMAP_SHA256
    string "Generated ShinyGo60 keymap SHA-256"
    default "0000000000000000000000000000000000000000000000000000000000000000"
    depends on SHINYGO60
    help
      SHA-256 of the exact keymap bytes used by the headless builder.
```
